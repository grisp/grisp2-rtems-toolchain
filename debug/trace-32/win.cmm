// T32 Thu Jan  9 09:58:44 2020

 B::
 
 TOOLBAR ON
 STATUSBAR ON
 FramePOS 0.0,0.0,,,Maximized
 WinPAGE.RESet
 
 WinPAGE.Create P000
 WinCLEAR
 
 WinPOS 0.16667 0.0 77. 20. 0. 0. W002
 ws.register
 
 WinPOS 185.17 0.0 110. 19. 5. 0. W000
 ws.Var.Frame
 
 WinPOS 185.83 25.308 110. 6. 23. 1. W005
 WinTABS 13. 16. 0. 0. 0. 0. 0.
 ws.Break.List
 
 WinPOS 186.17 37.769 110. 19. 0. 1. W001
 WinTABS 57. 26.
 ws.sYmbol.Browse
 
 WinPOS 81.5 0.46154 43. 21. 0. 0. W006
 ws.AREA
 
 WinPOS 1.6667 25.308 119. 25. 13. 1. W004
 WinTABS 10. 10. 25. 62.
 ws.data.list
 
 WinPOS 128.83 0.15385 40. 17. 0. 0. W003
 system
 
 WinPAGE.select P000
 
 ENDDO
